## external/Config.in
```kconfig
menu "snes-pi-os"

source "$BR2_EXTERNAL_SNESPI_PATH/package/pisnes/Config.in"
source "$BR2_EXTERNAL_SNESPI_PATH/package/snes-launcher/Config.in"
source "$BR2_EXTERNAL_SNESPI_PATH/package/snespi-homebrew/Config.in"

endmenu
```

## external/package/pisnes/Config.in
```kconfig
config BR2_PACKAGE_PISNES
	bool "pisnes"
	depends on BR2_arm # rpi-userland (EGL/GLES legado da Broadcom)
	depends on BR2_INSTALL_LIBSTDCPP # rpi-userland
	depends on BR2_TOOLCHAIN_HAS_THREADS # rpi-userland, alsa-lib, libglib2
	depends on !BR2_STATIC_LIBS # rpi-userland
	depends on BR2_USE_WCHAR # libglib2
	depends on BR2_USE_MMU # libglib2
	select BR2_PACKAGE_RPI_USERLAND
	select BR2_PACKAGE_SDL
	select BR2_PACKAGE_SDL_FBCON
	select BR2_PACKAGE_ALSA_LIB
	select BR2_PACKAGE_LIBGLIB2
	select BR2_PACKAGE_JPEG
	select BR2_PACKAGE_ZLIB
	help
	  PiSNES: emulador de SNES baseado no SNES9X 1.39, com vídeo
	  GLES2/dispmanx, áudio ALSA e entrada por SDL 1.2. Feito para
	  o Raspberry Pi 1.

	  Instala snes9x, snes9x.gui, snes9x.cfg e skins/ em
	  /usr/share/pisnes. O link roms/ aponta para /roms.

	  https://github.com/RetroPie/pisnes

comment "pisnes needs a toolchain w/ C++, threads, wchar, dynamic library"
	depends on BR2_arm
	depends on BR2_USE_MMU
	depends on !BR2_INSTALL_LIBSTDCPP || !BR2_TOOLCHAIN_HAS_THREADS || \
		!BR2_USE_WCHAR || BR2_STATIC_LIBS
```

## external/package/snes-launcher/Config.in
```kconfig
config BR2_PACKAGE_SNES_LAUNCHER
	bool "snes-launcher"
	depends on BR2_USE_MMU # fork()
	depends on BR2_TOOLCHAIN_HAS_THREADS # alsa-lib, música
	select BR2_PACKAGE_ALSA_LIB
	help
	  Frontend do snes-pi-os: lista as ROMs de /roms (com capa,
	  região e aviso de chip não suportado) e executa o PiSNES.
	  Desenha direto no framebuffer (/dev/fb0) e lê os controles
	  pelo evdev.

	  Toca música de fundo no menu (ALSA): /roms/musica.ogg ou .wav,
	  ou a música padrão (CC0) em /usr/share/snespi/musica.

	  Instala /usr/bin/snespi-launcher, as fontes em
	  /usr/share/snespi/fonts e a música padrão.
```

## external/package/snespi-homebrew/Config.in
```kconfig
config BR2_PACKAGE_SNESPI_HOMEBREW
	bool "snespi-homebrew"
	help
	  Coloca na partição ROMS da imagem dois jogos de teste de
	  licença livre (exemplos do OpenSNES, MIT), para validar o
	  aparelho logo depois de gravar o cartão:

	  - Teste - Breakout (OpenSNES): jogo completo (vídeo, som,
	    jogar e voltar ao menu)
	  - Teste - Controles (OpenSNES): mostra os dois controles e
	    acende cada botão apertado

	  Nada é instalado na raiz: os arquivos vão para a imagem do
	  cartão pelo post-image.sh.

	  https://github.com/k0b3n4irb/opensnes
```
